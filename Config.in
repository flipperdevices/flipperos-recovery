## package/compsize/Config.in
```kconfig
config BR2_PACKAGE_COMPSIZE
	bool "compsize"
	depends on BR2_USE_MMU # btrfs-progs
	depends on BR2_TOOLCHAIN_HAS_THREADS # btrfs-progs
	select BR2_PACKAGE_BTRFS_PROGS # <btrfs/ioctl.h>, <btrfs/ctree.h>
	help
	  compsize takes a list of files (or directories) on a btrfs
	  filesystem and reports their used compressed and uncompressed
	  sizes plus the effective compression ratio - i.e. how much space
	  btrfs transparent compression actually saved.

	  https://github.com/kilobyte/compsize

comment "compsize needs a toolchain w/ threads"
	depends on BR2_USE_MMU
	depends on !BR2_TOOLCHAIN_HAS_THREADS
```

## package/duperemove/Config.in
```kconfig
config BR2_PACKAGE_DUPEREMOVE
	bool "duperemove"
	depends on BR2_USE_MMU # glib2, sqlite
	depends on BR2_USE_WCHAR # glib2, libbsd
	depends on BR2_TOOLCHAIN_HAS_THREADS # pthread, glib2, libbsd
	depends on !BR2_STATIC_LIBS # libbsd
	select BR2_PACKAGE_SQLITE # hashfile database
	select BR2_PACKAGE_LIBGLIB2
	select BR2_PACKAGE_LIBBSD
	select BR2_PACKAGE_XXHASH # libxxhash (unbundled since 0.15)
	help
	  duperemove finds duplicate extents across a set of files and
	  submits them to the kernel for deduplication (btrfs / xfs
	  FIDEDUPERANGE), reclaiming space without altering file contents.
	  Pairs with compsize (which reports on-disk compression).

	  https://github.com/markfasheh/duperemove

comment "duperemove needs a toolchain w/ threads, wchar, dynamic libs"
	depends on BR2_USE_MMU
	depends on !BR2_TOOLCHAIN_HAS_THREADS || !BR2_USE_WCHAR || BR2_STATIC_LIBS
```

## package/flipctl/Config.in
```kconfig
config BR2_PACKAGE_FLIPCTL
	bool "flipctl"
	depends on BR2_PACKAGE_HOST_RUSTC_TARGET_ARCH_SUPPORTS # rust
	depends on BR2_TOOLCHAIN_HAS_THREADS # rust std
	depends on BR2_USE_MMU
	depends on BR2_INIT_SYSTEMD # runs from flipctl.service
	select BR2_PACKAGE_HOST_RUSTC
	help
	  flipctl on the Flipper One panel, built without app hosting:
	  no compositor, no Apps and no App Manager. It opens the SPI
	  panel's DRM card and reads the buttons from evdev itself, and
	  runs as root from the repository's flipctl.service with its
	  recovery drop-in.

	  https://github.com/flipperdevices/flipctl-slint

comment "flipctl needs systemd and a toolchain w/ threads and Rust support"
	depends on !BR2_PACKAGE_HOST_RUSTC_TARGET_ARCH_SUPPORTS || \
		!BR2_TOOLCHAIN_HAS_THREADS || !BR2_INIT_SYSTEMD
	depends on BR2_USE_MMU
```

## package/flipper-btrfs-tools/Config.in
```kconfig
config BR2_PACKAGE_FLIPPER_BTRFS_TOOLS
	bool "flipper-btrfs-tools"
	help
	  Flipper btrfs profile/snapshot tooling: create/delete/rename
	  profiles, snapshot send/receive/delete, maintenance, and
	  show-space. Their -d mode targets the unmounted profiles
	  partition, so they run from recovery against the internal
	  btrfs. Installed to /usr/local/sbin, with every shared helper
	  the tools source (flipper-btrfs.sh, flipper-bls.sh,
	  flipper-rootinfo.sh and the account-merge awk script) in
	  /usr/lib.

	  Runtime deps (enabled separately in the defconfig): btrfs-progs,
	  compsize, duperemove, git (migrate-profile's `git merge-file` merge
	  engine), diffutils (its `cmp`), acl (its `rsync -aHAX` needs ACL
	  support), findmnt/flock (util-linux), mawk. migrate-profile replays
	  packages with the profile's own apt inside a chroot, so recovery
	  itself needs no apt/dpkg.

	  https://github.com/flipperdevices/flipperos-btrfs-tools
```

## package/flipper-usb-gadget/Config.in
```kconfig
config BR2_PACKAGE_FLIPPER_USB_GADGET
	bool "flipper-usb-gadget"
	depends on BR2_INIT_SYSTEMD # systemd units, .link, udev rules
	help
	  USB-gadget support for Flipper One, shared with the main OS:
	  the configfs gadget engine (usb-gadget-setup.sh) and its preset
	  launchers in /usr/local/bin, the NCM+MSC+MTP composite unit and
	  the Type-C replug helper, the 10-flipusb.link rename and the two
	  udev rules that re-manage flipusb0 in NetworkManager and trigger
	  a replug.

	  Only the composite unit is installed; the other presets' units
	  would let preset-all enable them and race for the single UDC.
	  The composite is started by the enable symlink in the board
	  overlay, and umtprd (BR2_PACKAGE_UMTPRD) serves its MTP function.

	  https://github.com/flipperdevices/flipperone-linux-build-scripts

comment "flipper-usb-gadget needs systemd"
	depends on !BR2_INIT_SYSTEMD
```
